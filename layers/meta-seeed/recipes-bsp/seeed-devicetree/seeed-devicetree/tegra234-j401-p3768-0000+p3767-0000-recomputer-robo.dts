// SPDX-License-Identifier: GPL-2.0-only
// SPDX-FileCopyrightText: Copyright (c) 2023, NVIDIA CORPORATION & AFFILIATES.  All rights reserved.

/dts-v1/;

#include "tegra234-j401-p3768-0000+p3767-recomputer-robo-common.dts"

/ {
        #include "seeed-j401-module-compat.dtsi"
        model = "NVIDIA Jetson Orin NX Seeed recomputer classic Robotics";
};
#include "seeed-j401-module-tuning.dtsi"
