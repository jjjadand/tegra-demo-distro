## layers/meta-seeed/conf/layer.conf
```bitbake
BBPATH .= ":${LAYERDIR}"

BBFILES += "${LAYERDIR}/recipes-*/*/*.bb \
            ${LAYERDIR}/recipes-*/*/*.bbappend"

BBFILE_COLLECTIONS += "seeed"
BBFILE_PATTERN_seeed = "^${LAYERDIR}/"
BBFILE_PRIORITY_seeed = "8"

LAYERSERIES_COMPAT_seeed = "wrynose"
```

## layers/meta-seeed/conf/machine/include/seeed-orin-j401.inc
```bitbake
PREFERRED_PROVIDER_virtual/dtb = "seeed-devicetree"
IMAGE_CLASSES:append = " seeed-recomputer-super-tegraflash"

SEEED_MODULE_SKU ?= "${SEEED_DEFAULT_MODULE_SKU}"
SEEED_MODULE_BPMP_SKU = "${SEEED_MODULE_SKU}"
TEGRA_BOARDSKU = "${SEEED_MODULE_SKU}"
TEGRA_FLASHVAR_BPFDTB_FILE = "tegra234-bpmp-3767-${SEEED_MODULE_BPMP_SKU}-3768-super.dtb"

TEGRA_FLASHVAR_ODMDATA ?= "gbe-uphy-config-9,hsstp-lane-map-3,hsio-uphy-config-0"
TEGRA_FLASHVAR_PINMUX_CONFIG = "${SEEED_PINMUX_CONFIG}"
TEGRA_FLASHVAR_PMC_CONFIG = "${SEEED_PMC_CONFIG}"
KERNEL_DEVICETREE = "${SEEED_DTB}"

SEEED_MODULE_DTC_DEFINE = "SEEED_MODULE_SKU_${SEEED_MODULE_SKU}"
DTC_PPFLAGS:append = " -D${SEEED_MODULE_DTC_DEFINE}"

TEGRA_PLUGIN_MANAGER_OVERLAYS:append = " ${SEEED_OVERLAYS}"
TEGRA_FLASHVAR_DCE_OVERLAY = "${SEEED_DCE_OVERLAY}"
```

## layers/meta-seeed/conf/machine/recomputer-orin-j40mini.conf
```bitbake
#@TYPE: Machine
#@NAME: Seeed reComputer J40 Mini

SEEED_DEFAULT_MODULE_SKU = "0000"
SEEED_SUPPORTED_MODULE_SKUS = "0000 0001 0003 0004"
MACHINEOVERRIDES =. "p3768-0000-p3767-${SEEED_MODULE_SKU}:"
require conf/machine/p3768-0000-p3767-${SEEED_MODULE_SKU}.conf
require conf/machine/include/seeed-orin-j401.inc

SEEED_DTS_TEMPLATE = "tegra234-j40mini-p3768-0000+p3767-0000-recomputer.dts"
SEEED_DTB = "tegra234-j40mini-p3768-0000+p3767-${SEEED_MODULE_SKU}-recomputer.dtb"
SEEED_PINMUX_CONFIG = "recomputer-mini-orin-j40-pinmux-p3767-0000.dtsi"
SEEED_PMC_CONFIG = "recomputer-mini-orin-j40-padvoltage-p3767-0000.dtsi"
SEEED_DCE_OVERLAY = ""
SEEED_OVERLAYS = ""
```

## layers/meta-seeed/conf/machine/recomputer-orin-robotics-j401-gmsl.conf
```bitbake
#@TYPE: Machine
#@NAME: Seeed reComputer Robotics J401 GMSL

SEEED_DEFAULT_MODULE_SKU = "0000"
SEEED_SUPPORTED_MODULE_SKUS = "0000 0001 0003 0004"
MACHINEOVERRIDES =. "p3768-0000-p3767-${SEEED_MODULE_SKU}:"
require conf/machine/p3768-0000-p3767-${SEEED_MODULE_SKU}.conf
require conf/machine/include/seeed-orin-j401.inc

SEEED_DTS_TEMPLATE = "tegra234-j401-p3768-0000+p3767-0000-recomputer-robo-gmsl.dts"
SEEED_DTB = "tegra234-j401-p3768-0000+p3767-${SEEED_MODULE_SKU}-recomputer-robo-gmsl.dtb"
SEEED_PINMUX_CONFIG = "recomputer-robotics-orin-j40-pinmux-p3767-0000.dtsi"
SEEED_PMC_CONFIG = "recomputer-robotics-orin-j40-padvoltage-p3767-0000.dtsi"
SEEED_DCE_OVERLAY = ""
SEEED_OVERLAYS = "tegra234-seeed-gmsl-recomputer-robo-3g-overlay.dtbo tegra234-seeed-gmsl-recomputer-robo-6g-overlay.dtbo"
```

## layers/meta-seeed/conf/machine/recomputer-orin-robotics-j401.conf
```bitbake
#@TYPE: Machine
#@NAME: Seeed reComputer Robotics J401

SEEED_DEFAULT_MODULE_SKU = "0000"
SEEED_SUPPORTED_MODULE_SKUS = "0000 0001 0003 0004"
MACHINEOVERRIDES =. "p3768-0000-p3767-${SEEED_MODULE_SKU}:"
require conf/machine/p3768-0000-p3767-${SEEED_MODULE_SKU}.conf
require conf/machine/include/seeed-orin-j401.inc

SEEED_DTS_TEMPLATE = "tegra234-j401-p3768-0000+p3767-0000-recomputer-robo.dts"
SEEED_DTB = "tegra234-j401-p3768-0000+p3767-${SEEED_MODULE_SKU}-recomputer-robo.dtb"
SEEED_PINMUX_CONFIG = "recomputer-robotics-orin-j40-pinmux-p3767-0000.dtsi"
SEEED_PMC_CONFIG = "recomputer-robotics-orin-j40-padvoltage-p3767-0000.dtsi"
SEEED_DCE_OVERLAY = ""
SEEED_OVERLAYS = ""
```

## layers/meta-seeed/conf/machine/recomputer-orin-super-j401.conf
```bitbake
#@TYPE: Machine
#@NAME: Seeed reComputer Super J401

SEEED_DEFAULT_MODULE_SKU = "0000"
SEEED_SUPPORTED_MODULE_SKUS = "0000 0001 0003 0004"
MACHINEOVERRIDES =. "p3768-0000-p3767-${SEEED_MODULE_SKU}:"
require conf/machine/p3768-0000-p3767-${SEEED_MODULE_SKU}.conf
require conf/machine/include/seeed-orin-j401.inc

SEEED_DTS_TEMPLATE = "tegra234-j401-p3768-0000+p3767-0000-recomputer-super.dts"
SEEED_DTB = "tegra234-j401-p3768-0000+p3767-${SEEED_MODULE_SKU}-recomputer-super.dtb"
SEEED_PINMUX_CONFIG = "recomputer-super-orin-j401-pinmux-p3767-hdmi-a03.dtsi"
SEEED_PMC_CONFIG = "recomputer-super-orin-j401-padvoltage-p3767-hdmi-a03.dtsi"
SEEED_DCE_OVERLAY = "tegra234-dcb-p3767-0000-hdmi.dtbo"
SEEED_OVERLAYS = "tegra234-dcb-p3767-0000-hdmi.dtbo tegra234-p3767-camera-p3768-imx219-quad-seeed.dtbo"
```

## layers/meta-seeed/conf/machine/recomputer-rugged-orin-j401.conf
```bitbake
#@TYPE: Machine
#@NAME: Seeed reComputer Rugged J401

SEEED_DEFAULT_MODULE_SKU = "0000"
SEEED_SUPPORTED_MODULE_SKUS = "0000 0001 0003 0004"
MACHINEOVERRIDES =. "p3768-0000-p3767-${SEEED_MODULE_SKU}:"
require conf/machine/p3768-0000-p3767-${SEEED_MODULE_SKU}.conf
require conf/machine/include/seeed-orin-j401.inc

SEEED_DTS_TEMPLATE = "tegra234-j401-p3768-0000+p3767-0000-recomputer-rugged.dts"
SEEED_DTB = "tegra234-j401-p3768-0000+p3767-${SEEED_MODULE_SKU}-recomputer-rugged.dtb"
SEEED_PINMUX_CONFIG = "recomputer-rugged-orin-j401-bct-pinmux-p3767-0000.dtsi"
SEEED_PMC_CONFIG = "recomputer-rugged-orin-j401-bct-padvoltage-default-p3767-0000.dtsi"
SEEED_DCE_OVERLAY = "tegra234-dcb-p3767-0000-hdmi.dtbo"
SEEED_OVERLAYS = "tegra234-dcb-p3767-0000-hdmi.dtbo"
```
